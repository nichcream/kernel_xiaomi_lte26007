## arch/arm/plat-lc/drivers/ion/Kconfig
```kconfig
config ION_LC
        tristate "Ion for Leadcore"
        depends on ION
        help
          Choose this option if you wish to use ion on an Leadcore platform.
```

## arch/arm/plat-lc/drivers/leds/Kconfig
```kconfig
#
# led drivers configuration
#

comment "LED drivers"

config LEDS_AW2013
       tristate "LED driver for AW2013 RGB LED"
       depends on LEDS_CLASS
       depends on I2C
       select LEDS_TRIGGERS
       help
       This option enables support for AW2013 RGB LED driver chips
       accessed via the I2C bus.
```

## arch/arm/plat-lc/drivers/pmic/Kconfig
```kconfig
config COMIP_PMIC
	bool "Leadcore PMIC Support"
	help
	  Say yes here to support for Leacore PMIC.

config COMIP_CALIBRATION
	bool "Leadcore 32K Clock Calibration Support"
	depends on PLAT_LC
	help
	  Say yes here to support for 32K Clock Calibration.

config BATINFO_FILE
	string "batinfo file"
	default "/data/last_batinfo.dat"
	---help---
	Path to the batinfo file.

config COMIP_LC1100HT
	bool "Leadcore LC1100HT PMIC Support"
	depends on I2C && I2C_COMIP && COMIP_PMIC
	select COMIP_PMIC_REBOOT
	help
	  Say yes here to support for Leadcore LC1100HT. This is
	  a Power Management IC. This driver provies common support for
	  accessing the device, additional drivers must be enabled in order
	  to use the functionality of the device.

config COMIP_LC1100H
	bool "Leadcore LC1100H PMIC Support"
	depends on I2C && I2C_COMIP && COMIP_PMIC
	select COMIP_PMIC_REBOOT
	help
	  Say yes here to support for Leadcore LC1100H. This is
	  a Power Management IC. This driver provies common support for
	  accessing the device, additional drivers must be enabled in order
	  to use the functionality of the device.

config COMIP_LC1132
	bool "Leadcore LC1132 PMIC&CODEC Support"
	depends on I2C && I2C_COMIP && COMIP_PMIC
	select COMIP_PMIC_REBOOT
	help
	  Say yes here to support for Leadcore LC1132.

config COMIP_LC1160
	bool "Leadcore LC1160 PMIC&CODEC Support"
	depends on I2C && I2C_COMIP && COMIP_PMIC
	select COMIP_PMIC_REBOOT
	help
	  Say yes here to support for Leadcore LC1160.

config BUCK_NCP6335
	bool "On Semiconductor NCP6335 Support"
	depends on I2C && I2C_COMIP
	help
	  Say yes here to support for On Semi NCP6335.

config BUCK_FAN53555
	bool "Fairchild Semiconductor FAN53555 Support"
	depends on I2C && I2C_COMIP
	help
	  Say yes here to support for On Semi FAN53555.

config LC1100H_ADC
	tristate "lc1100h adc"
	depends on COMIP_LC1100H
	help
	  Say Y to enable support for lc1100h adc.

config LC1100H_MONITOR_BATTERY
	tristate "lc1100h monitor battery"
	depends on COMIP_LC1100H
	help
	  Say Y to enable support for lc1100h monitor battery.

config LC1100H_BATTERY
	tristate "lc1100h battery"
	depends on I2C && I2C_COMIP
	help
	  Say Y to enable support for lc1100h battery.

config LC1132_ADC
	tristate "lc1132 adc"
	depends on COMIP_LC1132
	help
	  Say Y to enable support for lc1132 adc.

config LC1132_MONITOR_BATTERY
	tristate "lc1132 monitor battery"
	depends on COMIP_LC1132
	help
	  Say Y to enable support for lc1132 monitor battery.

config LC1160_ADC
	tristate "lc1160 adc"
	depends on COMIP_LC1160
	help
	  Say Y to enable support for lc1160 adc.

config LC1160_PWM
	tristate "lc1160 pwm"
	depends on COMIP_LC1160
	help
	  Say Y to enable support for lc1160 pwm.

config LC1160_MONITOR_BATTERY
	tristate "lc1160 monitor battery"
	depends on COMIP_LC1160
	help
	  Say Y to enable support for lc1160 monitor battery.

config CHARGER_BQ24158
	tristate "BQ24158 charger"
	depends on I2C && I2C_COMIP
	help
	  Say Y to enable support for BQ24158 battery charger

config CHARGER_BQ2419X
	tristate "bq2419x charger"
	depends on I2C && I2C_COMIP
	help
	  Say Y to enable support for bq2419x charger

config CHARGER_BQ24296
	tristate "BQ24296 charger"
	depends on I2C && I2C_COMIP
	help
	  Say Y to enable support for BQ24296 battery charger
config CHARGER_NCP1851
	tristate "ncp1851 charger"
	depends on I2C && I2C_COMIP
	help
	  Say Y to enable support for ncp1851 charger

config BATTERY_BQ27510
	tristate "bq27510-battery"
	depends on I2C && I2C_COMIP
	help
	  Say Y to enable support for bq27510-battery

config BATTERY_BQ27421
	tristate "bq27421-battery"
	depends on I2C && I2C_COMIP
	help
	  Say Y to enable support for bq27421-battery

config BATTERY_MAX17058
	tristate "max17058-battery"
	depends on I2C && I2C_COMIP
	help
	  Say Y to enable support for max17058-battery

config BAT_ID_BQ2022A
        bool "TI BQ2022A BAT_ID Support"
        help
          Say yes here to support for TI BQ2022A. This is
          a BAT_ID IC. This driver provies common support for
          accessing the device, additional drivers must be enabled in order
          to use the functionality of the device.

config CW201X_BATTERY
	tristate "CW201X battery driver"
	help
	  Say Y to enable support for the cw201x on the Rockchip
```

## arch/arm/plat-lc/drivers/radio/realtek/Kconfig
```kconfig
#
# TI's wl128x FM driver based on TI's ST driver.
#
menu "Realtek FM Chip driver"
config RADIO_RTK8723B
	tristate "Realtek 8723B FM radio receiver support"
	depends on I2C
	help
	Choose Y here if you have this FM radio chip.
	
	To compile this driver as a module, choose M here; the module will be called radio_rtk8723b

endmenu
```

## arch/arm/plat-lc/drivers/sensor/Kconfig
```kconfig
config SENSORS_LIS3DH
        tristate "LIS3DH accelemetor support"
        default n
        depends on I2C
        ---help---
          If you say yes here you get support for LIS3DH

config SENSORS_BMA222E
        tristate "BMA222E support"
        default n
        depends on I2C
        ---help---
          If you say yes here you get support for BMA222E

config SENSORS_KIONIX_ACCEL
        tristate "KIONIX accelerometer support"
        default n
        depends on I2C
        ---help---
          If you say yes here you get support for the Kionix digital 3-axis accelerometer

config SENSORS_MC3XXX
        tristate "MC3XXX accelerometer support"
        default n
	select INPUT_POLLDEV
        depends on I2C
        ---help---
          If you say yes here you get support for the Kionix digital 3-axis accelerometer

config SENSORS_MMA8X5X
        tristate "freescale accelerometer support"
        default n
        select INPUT_POLLDEV
        depends on I2C
        ---help---
          If you say yes here you get support for the freescale mma8x5x 3-axis accelerometer

config SENSORS_ST480
        tristate "ST480 Magnetic Sensor support"
        default n
        depends on I2C
        ---help---
          If you say yes here you get support for ST480
          
config SENSORS_HSCDTD007A
        tristate "HSCDTD007A Magnetic Sensor support"
        default n
        depends on I2C
        ---help---
          If you say yes here you get support for ST480

config SENSORS_L3GD20
        tristate "L3GD20 gyroscope Sensor support"
        default n
        depends on I2C
        ---help---
          If you say yes here you get support for L3GD20

config SENSORS_AK09911
	tristate "AK09911 compass support"
	default n
	depends on I2C
        ---help---
	  If you say yes here you get support for Asahi Kasei's
	  orientation sensor AK09911.

config SENSORS_LSM330
        tristate "LSM330 ACC GYR support"
        default n
        depends on I2C
        ---help---
          If you say yes here you get support for LSM330

config SENSORS_INV_MPU6880
        tristate "INV ACC GYR support"
        default n
        depends on I2C
        ---help---
          If you say yes here you get support for INV
          
config SENSORS_XYZ
        tristate "Gsensor Direction config"
        default n
        ---help---
          If you say yes here XYZ direction is support
config SENSORS_YXZ
        tristate "Gsensor Direction config"
        default n
        ---help---
          If you say yes here YXZ direction is support
config SENSORS_IOO
        tristate "Gsensor Direction config"
        default n
        ---help---
          If you say yes here 100 direction is support
config SENSORS_IOI
        tristate "Gsensor Direction config"
        default n
        ---help---
          If you say yes here 101 direction is support
	  
source "arch/arm/plat-lc/drivers/sensor/light_prox/Kconfig"
source "arch/arm/plat-lc/drivers/sensor/compass_alps/Kconfig"
source "arch/arm/plat-lc/drivers/sensor/mmc3416x/Kconfig"
source "arch/arm/plat-lc/drivers/sensor/mir3da/Kconfig"
source "arch/arm/plat-lc/drivers/sensor/iio/Kconfig"
source "arch/arm/plat-lc/drivers/sensor/qst/Kconfig"
```

## arch/arm/plat-lc/drivers/sensor/compass_alps/Kconfig
```kconfig
config SENSORS_HSCDTD007A
        tristate "HSCDTD007A Magnetic Sensor support"
        default n
        depends on I2C
        ---help---
          If you say yes here you get support for ST480
```

## arch/arm/plat-lc/drivers/sensor/light_prox/Kconfig
```kconfig
#
# light and proximity driver configuration
#
menuconfig LIGHT_PROXIMITY
	bool "Light and Proximity"
	help
	  Say Y here, and a list of supported touchscreens will be displayed.
	  This option doesn't affect the kernel.

	  If unsure, say Y.

if LIGHT_PROXIMITY

config LIGHT_PROXIMITY_APDS990X
	tristate "apds990x light and proximity sensor"
	depends on  I2C

config LIGHT_PROXIMITY_LTR558
        tristate "ltr558 light and proximity sensor"
        depends on  I2C

config LIGHT_PROXIMITY_TMD22713T
	tristate "tmd22713t light and proximity sensor"
	depends on  I2C

config LIGHT_PROXIMITY_TAOS_TMD22713T
	tristate "tmd22713t light and proximity sensor"
	depends on  I2C

config LIGHT_PROXIMITY_LTR55XALS
        tristate "ltr55x light and proximity sensor"
        depends on  I2C

config LIGHT_PROXIMITY_CM36283
        tristate "cm36283 light and proximity sensor"
        depends on  I2C

config LIGHT_PROXIMITY_GP2AP030
        tristate "gp2ap030 light and proximity sensor"
        depends on  I2C

config LIGHT_PROXIMITY_STK3X1X
	tristate "SensorTek stk3x1x light and proximity sensor"
	depends on I2C

config LIGHT_PROXIMITY_RPR521
	tristate "SensorTek rpr521 light and proximity sensor"
	depends on I2C

endif
```

## arch/arm/plat-lc/drivers/sensor/mmc3416x/Kconfig
```kconfig
#
# Magnetometer Configuration
#

config SENSORS_MMC3416XPJ_MAG
	tristate "MMC3416xPJ magnetic sensor support"
	depends on I2C=y
	default n
	select INPUT_POLLDEV
	help
	  If you say yes here you get support for MEMSIC's
	  magnetic sensors MMC3416xPJ.
```

## arch/arm/plat-lc/drivers/sensor/qst/Kconfig
```kconfig
#
# Magnetometer Configuration
#

config SENSORS_QMC6983
	tristate "QMC6983 magnetic sensor support"
	depends on I2C=y
	default n
	select INPUT_POLLDEV
	help
	  If you say yes here you get support for QST's
	  magnetic sensors QMC6983.
	  
```

## arch/arm/plat-lc/drivers/sound/Kconfig
```kconfig
config SND_COMIP_I2S
	tristate "Leadcore COMIP I2S support"
	select DMAS_COMIP

config SND_COMIP_VIRTUAL
	tristate "Leadcore COMIP Virtual PCM support"

config SND_COMIP_PCM
	tristate "Leadcore COMIP PCM support"
	
config SND_COMIP_LOWPOWER
	tristate "Leadcore COMIP LowPower Audio support"	

config COMIP_LC1120
        bool "Leadcore LC1120 CODEC Support"
        depends on I2C && I2C_COMIP
        help
          This driver supports the leadcore LC1120 driver. the LC1120 is a audio codec

config SND_SOC_ALL_CODECS
        tristate "Build all ASoC CODEC drivers"
        select SND_COMIP_LC1120  if COMIP_LC1120
        select SND_COMIP_LC1132  if COMIP_LC1132
        select SND_COMIP_LC1160  if COMIP_LC1160
        help
          Normally ASoC codec drivers are only built if a machine driver which
          uses them is also built since they are only usable with a machine
          driver.  Selecting this option will allow these drivers to be built
          without an explicit machine driver for test and development purposes.

          Support for the bus types used to access the codecs to be built must
          be selected separately.

          If unsure select "N".

config SND_COMIP_CODECS
        tristate

config SND_COMIP_LC1120
        tristate
        select SND_COMIP_CODECS

config SND_COMIP_LC1132
        tristate
        select SND_COMIP_CODECS

config SND_COMIP_LC1160
        tristate
```
