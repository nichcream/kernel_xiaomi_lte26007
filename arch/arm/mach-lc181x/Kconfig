## arch/arm/plat-lc/drivers/camera/sensors/Kconfig
```kconfig
if VIDEO_COMIP
menu "Camera sensors"
        config VIDEO_OV3650
                tristate "OmniVision OV3650 sensor support"
                depends on I2C && VIDEO_V4L2
                ---help---
                This is a Video4Linux2 sensor-level driver for the OmniVision
                OV3650 3.0 Mpixel camera.

        config VIDEO_S5K4E1
                tristate "Samsung S5K4E1 sensor support"
                depends on I2C && VIDEO_V4L2
                ---help---
                This is a Video4Linux2 sensor-level driver for the Samsung
                S5K4E1 5.0 Mpixel camera.

        config VIDEO_S5K3H2
                tristate "Samsung S5K3H2 sensor support"
                depends on I2C && VIDEO_V4L2
                ---help---
                This is a Video4Linux2 sensor-level driver for the Samsung
                S5K3H2 8.0 Mpixel camera.

        config VIDEO_OV2680
                tristate "OmniVision OV2680 sensor support"
                depends on I2C && VIDEO_V4L2
                ---help---
                This is a Video4Linux2 sensor-level driver for the OmniVision
                OV2680 2 Mpixel camera.

        config VIDEO_OV9760
                tristate "OmniVision OV9760 sensor support"
                depends on I2C && VIDEO_V4L2
                ---help---
                This is a Video4Linux2 sensor-level driver for the OmniVision
                OV9760 1.5 Mpixel camera.
				
        config VIDEO_OV9724
                tristate "OmniVision OV9724 sensor support"
                depends on I2C && VIDEO_V4L2
                ---help---
                This is a Video4Linux2 sensor-level driver for the OmniVision
                OV9724 1.0 Mpixel camera.
				
        config VIDEO_OV5647
                tristate "OmniVision OV5647 sensor support"
                depends on I2C && VIDEO_V4L2
                 ---help---
                This is a Video4Linux2 sensor-level driver for the OmniVision
                OV5647 5.0 Mpixel camera.

        config VIDEO_OV5648_2LANE_19M
                tristate "OmniVision OV5648 sensor(2 lane,19M mclk) support"
                depends on I2C && VIDEO_V4L2
                 ---help---
                This is a Video4Linux2 sensor-level driver for the OmniVision
                OV5648 5.0 Mpixel camera.

	config VIDEO_OV4689
                tristate "OmniVision OV4689 sensor support"
                depends on I2C && VIDEO_V4L2
                 ---help---
                This is a Video4Linux2 sensor-level driver for the OmniVision
                OV4689 5.0 Mpixel camera.

         config VIDEO_OV5648_2LANE_26M
                tristate "OmniVision OV5648 sensor(2 lane,26M mclk) support"
                depends on I2C && VIDEO_V4L2
                 ---help---
                This is a Video4Linux2 sensor-level driver for the OmniVision
                OV5648 5.0 Mpixel camera.

	config VIDEO_OV8865
                tristate "OmniVision OV8865 sensor support"
                depends on I2C && VIDEO_V4L2
                 ---help---
                This is a Video4Linux2 sensor-level driver for the OmniVision
                OV8865 8.0 Mpixel camera.

	config VIDEO_OV5648_PIP
		tristate "OmniVision OV5648_pip sensor support"
		depends on I2C && VIDEO_V4L2
		 ---help---
		This is a Video4Linux2 sensor-level driver for the OmniVision
		OV5648pip 5.0 Mpixel camera.

       config VIDEO_OV5693
                tristate "OmniVision OVOV5693 sensor support"
                depends on I2C && VIDEO_V4L2
                 ---help---
                This is a Video4Linux2 sensor-level driver for the OmniVision
                OVOV5693 5.0 Mpixel camera.

        config VIDEO_OV8825
                tristate "OmniVision OV8825 sensor support"
                depends on I2C && VIDEO_V4L2
                ---help---
                This is a Video4Linux2 sensor-level driver for the OmniVision
                OV8825 8.0 Mpixel camera.

        config VIDEO_OV8850
                tristate "OmniVision OV8850 sensor support"
                depends on I2C && VIDEO_V4L2
                ---help---
                This is a Video4Linux2 sensor-level driver for the OmniVision
                OV8850 8.0 Mpixel camera.
		
        config VIDEO_OV12830
                tristate "OmniVision OV12830 sensor support"
                depends on I2C && VIDEO_V4L2
                ---help---
                This is a Video4Linux2 sensor-level driver for the OmniVision
                OV12830 12.8 Mpixel camera.

        config VIDEO_OV13850
               tristate "OmniVision OV13850 sensor support"
               depends on I2C && VIDEO_V4L2
               ---help---
               This is a Video4Linux2 sensor-level driver for the OmniVision
               OV13850 13.2 Mpixel camera.

        config VIDEO_HM5065
                tristate "Himax HM5065 sensor with dvp interface support"
                depends on I2C && VIDEO_V4L2
                ---help---
                This is a Video4Linux2 sensor-level driver for the Himax
                HM5065 5.0 Mpixel camera.

	config VIDEO_HM5040
               tristate "Himax HM5040 sensor support"
               depends on I2C && VIDEO_V4L2
               ---help---
               This is a Video4Linux2 sensor-level driver for the
               Himax HM5040 13.2 Mpixel camera.

	config VIDEO_HM2056
               tristate "Himax HM2056 sensor support"
               depends on I2C && VIDEO_V4L2
               ---help---
               This is a Video4Linux2 sensor-level driver for the
               Himax HM2056 2 Mpixel camera.

       config VIDEO_HM2058
                tristate "Himax HM2058 sensor with dvp interface support"
                depends on I2C && VIDEO_V4L2
                ---help---
                This is a Video4Linux2 sensor-level driver for the Himax
                HM2058 2.0 Mpixel camera.

        config VIDEO_GC2035
                tristate "GalaxyCore GC2035 sensor with dvp interface support"
                depends on I2C && VIDEO_V4L2
                ---help---
                This is a Video4Linux2 sensor-level driver for the GalaxyCore
                GC2035 2.0 Mpixel camera.

	config VIDEO_GC2145_2LANE_26M
                tristate "GalaxyCore GC2145 sensor(2 lane,26M mclk) with mipi interface support"
                depends on I2C && VIDEO_V4L2
                ---help---
                This is a Video4Linux2 sensor-level driver for the GalaxyCore
                GC2145 2.0 Mpixel camera.

	config VIDEO_GC2145_1LANE_19M
                tristate "GalaxyCore GC2145 sensor(1 lane,19M mclk) with mipi interface support"
                depends on I2C && VIDEO_V4L2
                ---help---
                This is a Video4Linux2 sensor-level driver for the GalaxyCore
                GC2145 2.0 Mpixel camera.

        config VIDEO_GC2035_MIPI
                tristate "GalaxyCore GC2035 sensor with mipi interface support"
                depends on I2C && VIDEO_V4L2
                ---help---
                This is a Video4Linux2 sensor-level driver for the GalaxyCore
                GC2035 2.0 Mpixel camera.

        config VIDEO_GC2235
                tristate "GalaxyCore GC2235 sensor support"
                depends on I2C && VIDEO_V4L2
                ---help---
                This is a Video4Linux2 sensor-level driver for the GalaxyCore
                GC2235 2.0 Mpixel camera.

	config VIDEO_GC2355
                tristate "GalaxyCore GC2355 sensor support"
                depends on I2C && VIDEO_V4L2
                ---help---
                This is a Video4Linux2 sensor-level driver for the GalaxyCore
                GC2355 2.0 Mpixel camera.

        config VIDEO_GC5004
                tristate "GalaxyCore GC5004 sensor support"
                depends on I2C && VIDEO_V4L2
                ---help---
                This is a Video4Linux2 sensor-level driver for the GalaxyCore
                GC5004 5.0 Mpixel camera.
                
        config VIDEO_GC0310
                tristate "GalaxyCore GC0310 sensor support"
                depends on I2C && VIDEO_V4L2
                ---help---
                This is a Video4Linux2 sensor-level driver for the GalaxyCore
                GC0310 VGA camera.

        config VIDEO_GC0328
                tristate "GalaxyCore GC0328 sensor support"
                depends on I2C && VIDEO_V4L2
                ---help---
                This is a Video4Linux2 sensor-level driver for the GalaxyCore
                GC0328 VGA camera.

        config VIDEO_GC0329
                tristate "GalaxyCore GC0329 sensor support"
                depends on I2C && VIDEO_V4L2
                ---help---
                This is a Video4Linux2 sensor-level driver for the GalaxyCore
                GC0329 VGA camera.

        config VIDEO_BF3A50
                tristate "BYD BF3A50 sensor with dvp interface support"
                depends on I2C && VIDEO_V4L2
                ---help---
                This is a Video4Linux2 sensor-level driver for the BYD
                BF3A50 5.0 Mpixel camera.
  
        config VIDEO_BF3A20_MIPI
                tristate "BYD BF3A20 sensor with mipi interface support"
                depends on I2C && VIDEO_V4L2
                ---help---
                This is a Video4Linux2 sensor-level driver for the BYD
                BF3A20 2.0 Mpixel camera.

	config VIDEO_BF3905
		tristate "BYD BF3905 sensor with mipi interface support"
		depends on I2C && VIDEO_V4L2
		---help---
		This is a Video4Linux2 sensor-level driver for the BYD
		BF3905 0.3 Mpixel camera.

       config VIDEO_BF3920
                tristate "BYD BF3920 sensor with dvp interface support"
                depends on I2C && VIDEO_V4L2
                ---help---
                This is a Video4Linux2 sensor-level driver for the BYD
                BF3920 2.0 Mpixel camera.

       config VIDEO_BF3A03
                tristate "BYD BF3A03 sensor with dvp interface support"
                depends on I2C && VIDEO_V4L2
                ---help---
                This is a Video4Linux2 sensor-level driver for the BYD
                BF3A03 VGA camera.

        config VIDEO_BF3703
                tristate "BYD BF3703 sensor with dvp interface support"
                depends on I2C && VIDEO_V4L2
                ---help---
                This is a Video4Linux2 sensor-level driver for the BYD
                BF3703 VGA camera.

        config VIDEO_HI704
                tristate "Hynix HI704 sensor support"
                depends on I2C && VIDEO_V4L2
                ---help---
                This is a Video4Linux2 sensor-level driver for the Hynix
                HI704 VGA camera.

        config VIDEO_SP5408
               tristate "Superpix SP5408 sensor support"
               depends on I2C && VIDEO_V4L2
               ---help---
               This is a Video4Linux2 sensor-level driver for the Superpix
               SP5408 5.0 Mpixel camera.

        config VIDEO_SP5409
               tristate "Superpix SP5409 sensor support"
               depends on I2C && VIDEO_V4L2
               ---help---
               This is a Video4Linux2 sensor-level driver for the Superpix
               SP5409 5.0 Mpixel camera.

        config VIDEO_SP2508
               tristate "Superpix SP2508 sensor support"
               depends on I2C && VIDEO_V4L2
               ---help---
               This is a Video4Linux2 sensor-level driver for the Superpix
               SP2508 2.0 Mpixel camera.
               
        config VIDEO_SP2529
               tristate "Superpix SP2529 sensor support"
               depends on I2C && VIDEO_V4L2
               ---help---
               This is a Video4Linux2 sensor-level driver for the Superpix
               SP2529 2.0 Mpixel camera.
              
              
	config VIDEO_SP2529_26M
               tristate "Superpix SP2529 sensor support"
               depends on I2C && VIDEO_V4L2
               ---help---
               This is a Video4Linux2 sensor-level driver for the Superpix
               SP2529 2.0 Mpixel camera.
              
	config VIDEO_SP0A20
               tristate "Superpix SP0A20 sensor support"
               depends on I2C && VIDEO_V4L2
               ---help---
               This is a Video4Linux2 sensor-level driver for the Superpix
               SP0A20 2.0 Mpixel camera.

	config VIDEO_GC2155_FRONT
                tristate "GalaxyCore GC2155 sensor support"
                depends on I2C && VIDEO_V4L2
                ---help---
                This is a Video4Linux2 sensor-level driver for the GalaxyCore
                GC2155 2.0 Mpixel camera.

	config VIDEO_GC2155_BACK
                tristate "GalaxyCore GC2155 sensor support"
                depends on I2C && VIDEO_V4L2
                ---help---
                This is a Video4Linux2 sensor-level driver for the GalaxyCore
                GC2155 2.0 Mpixel camera.
	
	config VIDEO_GC2755
                tristate "GalaxyCore GC2755 sensor support"
                depends on I2C && VIDEO_V4L2
                ---help---
                This is a Video4Linux2 sensor-level driver for the GalaxyCore
                GC2755 2.0 Mpixel camera.
endmenu
endif
```

## arch/arm/plat-lc/drivers/gpu/Kconfig
```kconfig
menuconfig ARM_GPU
    tristate "Arm gpu support"
    default y
    ---help---
    Driver for gpu.

choice
	prompt "mali driver version"
	depends on ARM_GPU
	default MALI_DRIVER_MIDGARD_R4
	
config MALI_DRIVER_400
	bool "mali-400"
	help
	  Choose mali driver for mali-400.

config MALI_DRIVER_MIDGARD_R4
	bool "mali-midgard r4"
	help
	  Choose mali driver for mali-midgard r4.

config MALI_DRIVER_MIDGARD_R5
	bool "mali-midgard r5"
	help
	  Choose mali driver for mali-midgard r5.
endchoice

menu "ARM GPU Configuration"
choice
	prompt "mali performance level"
	depends on MALI_DRIVER_MIDGARD_R4 || MALI_DRIVER_MIDGARD_R5
	default MALI_DEFAULT_FREQ

config MALI_HIGH_FREQ
	bool "High Performance"
	help
	  Choose high frequency for better performance.

config MALI_DEFAULT_FREQ
	bool "Standard Performance"
	help
	  Choose standard frequency.

config MALI_LOW_FREQ
	bool "Low Performance"
	help
	  Choose low frequency for better consumption.
endchoice

choice
	prompt "Platform configuration"
	depends on MALI_DRIVER_MIDGARD_R4 || MALI_DRIVER_MIDGARD_R5
	default MALI_PLATFORM_VEXPRESS
	help
	  Select the SOC platform that contains a Mali Midgard GPU

config MALI_PLATFORM_VEXPRESS
	depends on ARCH_VEXPRESS && (ARCH_VEXPRESS_CA9X4 || ARCH_VEXPRESS_CA15X4)
	bool "Versatile Express"
config MALI_PLATFORM_VEXPRESS_VIRTEX7_40MHZ
	depends on ARCH_VEXPRESS && (ARCH_VEXPRESS_CA9X4 || ARCH_VEXPRESS_CA15X4)
	bool "Versatile Express w/Virtex7 @ 40Mhz"
config MALI_PLATFORM_GOLDFISH
	depends on ARCH_GOLDFISH
	bool "Android Goldfish virtual CPU"
config MALI_PLATFORM_PBX
	depends on ARCH_REALVIEW && REALVIEW_EB_A9MP && MACH_REALVIEW_PBX
	bool "Realview PBX-A9"
config MALI_PLATFORM_THIRDPARTY
	bool "Third Party Platform"
endchoice

if MALI_DRIVER_400
source "arch/arm/plat-lc/drivers/gpu/mali400/mali/Kconfig"
source "arch/arm/plat-lc/drivers/gpu/mali400/ump/Kconfig"
endif

if MALI_DRIVER_MIDGARD_R4
source "arch/arm/plat-lc/drivers/gpu/malit6xx_r4/gpu/arm/Kconfig"
endif

if MALI_DRIVER_MIDGARD_R5
source "arch/arm/plat-lc/drivers/gpu/malit6xx_r5/gpu/arm/Kconfig"
endif
endmenu
```

## arch/arm/plat-lc/drivers/gpu/mali400/ump/Kconfig
```kconfig
config UMP_MALI400
	tristate "UMP support for mali400"
	depends on MALI_DRIVER_400
	---help---
	  This enables support for the UMP memory allocation and sharing API.

	  To compile this driver as a module, choose M here: the module will be
	  called ump.

config UMP_DEBUG
	bool "Enable extra debug in UMP"
	depends on UMP_MALI400
	default y
	---help---
	  This enabled extra debug checks and messages in UMP.
```
